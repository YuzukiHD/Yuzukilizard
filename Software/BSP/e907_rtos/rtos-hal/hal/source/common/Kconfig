## Software/BSP/e907_rtos/rtos-hal/hal/source/common/Kconfig
```kconfig
menu "Common Option"

config DRIVER_SYSCONFIG
    bool "enable sysconfig"
	default y

config DMA_VMAREA_START_ADDRESS
    hex "non cacheable virtual memory start address"
	default 0x80000000

config DMA_COHERENT_HEAP
    bool "non cacheable heap support"
	default n

if DMA_COHERENT_HEAP

config DMA_COHERENT_HEAP_SIZE
    hex "non cacheable heap size(bytes)"
	default 0x100000

endif

endmenu
```

## Software/BSP/e907_rtos/rtos-hal/hal/source/spi/Kconfig
```kconfig
menu "SPI Devices"

config DRIVERS_SPI
    bool "enable spi driver"
        default n

config DRIVERS_SPI_PANIC_TRANSFER
    bool "support sp transfer if crash"
    depends on DRIVERS_SPI
        default n

config HAL_TEST_SPI
    bool "enable spi hal APIs test command"
    depends on DRIVERS_SPI
        default n

endmenu
```

## Software/BSP/e907_rtos/rtos/source/Kconfig.melis
```kconfig
# Kconfig - general configuration options

#
# Copyright (c) 2014-2015 Wind River Systems, Inc.
# Copyright (c) 2016 Intel Corporation
#
# Licensed under the Apache License, Version 2.0 (the "License");
# you may not use this file except in compliance with the License.
# You may obtain a copy of the License at
#
#     http://www.apache.org/licenses/LICENSE-2.0
#
# Unless required by applicable law or agreed to in writing, software
# distributed under the License is distributed on an "AS IS" BASIS,
# WITHOUT WARRANTIES OR CONDITIONS OF ANY KIND, either express or implied.
# See the License for the specific language governing permissions and
# limitations under the License.

menu "Environment Setup"

config SDK_RELEASE
	bool "sdk release for customer flag."
	default n

config DEBUG_INFO
	bool "Generate DEBUG Info."
	default y

config DEBUG_MACROS
	bool "show macros value on debugger"
	default n

config MODULES
	bool "Support Modules"
	default y

config MODVERSIONS
	bool "Modversions"
	default y
config BOOT_LOGO_BMP
	bool "boot logo bmp"
	default y 

config SHOW_FULL_VERSION
	bool "displays full version information."
	default y

config CROSS_COMPILE
	string "Cross-compiler tool prefix"
	default arm-melis-eabi-
	#default arm-none-eabi-
	#default arm-eabi-
	help
	Same as running 'make CROSS_COMPILE=prefix-' but stored for
  	default make runs in this kernel build directory.  You dont
  	need to set this unless you want the configured kernel build
  	directory to select the cross-compiler automatically.

config INIT_CARD_PRODUCT
	bool "Init mod card product"
	default n
	help

config LOG_DEFAULT_LEVEL
	int
	prompt "Default log level"
	default 1
	range 0 5
	help
	Sets log level for modules which dont specify it explicitly. When                                                                                                                                    
	set to 0 it means log wont be activated for those modules.
	Levels are:
	0 OFF, do not write by default
	1 LOG, default to only write SYS_LOG
	2 ERROR, default to only write SYS_LOG_ERR
	3 WARNING, default to write SYS_LOG_WRN in addition to previous level
	4 INFO, default to write SYS_LOG_INF in addition to previous levels
	5 DEBUG, default to write SYS_LOG_DBG in addition to previous levels

config CC_STACKPROTECTOR_STRONG
	bool "enable stack-protector"
	default y
	help
		Enable stack-proctor

config LOG_RELEASE
	bool "Log release option"
	default n
	help
		Reduce log

config BOOTUP_TURBO
	bool "bootup turbost"
	default n
	select SDK_THUMB_MODE
	help
		fast bootup

config DISABLE_ALL_DEBUGLOG
	bool "disable module log verbose"
	default n
	help
		Reduce all the log.

config PRINT_TIMESTAMP
	bool "printk prints timestamps"
	default n
	help
		printk prints timestamps.

config DYNAMIC_LOG_LEVEL_SUPPORT
	bool "dynamic log level support"
	help
	support set log level when system up.

if DYNAMIC_LOG_LEVEL_SUPPORT
choice
	prompt "Log Level Save"
	default LOG_LEVEL_STORAGE_NONE
	help
	select log level storage position

    config LOG_LEVEL_STORAGE_NONE
	bool "NONE"
	help
	"Just a global variable to save log level"
    config LOG_LEVEL_STORAGE_RTC
	bool "RTC"
	help
	"Use RTC register to save log level"
endchoice

config DYNAMIC_LOG_DEFAULT_LEVEL
	int "dynamic log level"
	default 5
	range 0 5
	help
	set dynamic log level, it will set initial value for g_log_level in printk.
	0 NONE, do not write by default
	1 LOG, default to only write SYS_LOG
	2 ERROR, default to only write SYS_LOG_ERR
	3 WARNING, default to write SYS_LOG_WRN in addition to previous level
	4 INFO, default to write SYS_LOG_INF in addition to previous levels
	5 DEBUG, default to write SYS_LOG_DBG in addition to previous levels"
endif

config FRAME_POINTER  
	bool "enable FP register as frame pointer"
	default y 
	select CC_OPTIMIZE_FOR_DEBUG
	help
		frame pointer enabled!

config FRAME_WARN
	int "Warn for stack frames larger than (needs gcc 4.4)"
	range 0 8192
	default 8192
	help
		Tell gcc to warn at build time for stack frames larger than this.
		Setting this too low will cause a lot of warnings.
		Setting it to 0 disables the warning.
		Requires gcc 4.4

choice
prompt "Io Lock"
default UART_CLI_USE_NONE

config UART_CLI_USE_NONE
	bool "Lock None"

config UART_CLI_USE_MUTEX
	bool "Use Mutex"

config UART_CLI_USE_SPINLOCK
	bool "Use SpinLock"

endchoice

choice
	prompt "Compiler optimization level"
	default CC_OPTIMIZE_FOR_DEBUG if FRAME_POINTER=y
	default CC_OPTIMIZE_FOR_SIZE if  FRAME_POINTER=n

	config CC_OPTIMIZE_FOR_SIZE
		bool "Optimize for release"
		help
		Enabling this option will pass "-Os" instead of "-O0" to your compiler
		resulting in a smaller kernel, this is the default optimization level
		for the kernel.

	config CC_OPTIMIZE_FOR_DEBUG
		bool "Optimize for debug"
		help
		Building the project with '-O0' optimization level for best performance 
		and generate most helpful debug infomation for GDB.
endchoice

config CC_OPTIMIZE_LEVEL
	int "Optimize for debug"
	default 0
	range 0 3
	depends on CC_OPTIMIZE_FOR_DEBUG
	help
	Building the project with optimization level(range 0-3)

config ARM_UNWIND
	bool "Enable stack unwinding support (EXPERIMENTAL)"
	default n if FRAME_POINTER=y
	help
		This option enables stack unwinding support in the kernel
		using the information automatically generated by the
		compiler. The resulting kernel image is slightly bigger but
		the performance is not affected. Currently, this feature
		only works with EABI compilers. If unsure say Y.

config OS_MELIS
       bool "Melis OS"
       default y

config KALLSYMS
		bool "keep Melis kernel symbols"
		default n

if KALLSYMS
	config KALLSYMS_ALL
		bool "keep Melis kernel all symbols"
		default n
endif

config SDK_THUMB_MODE
	bool "Enable Thumb mode sdk compile flags"
	depends on BOOTUP_TURBO
	help
		compile whole sdk with -mthumb flags.

config MELIS_GENERATE_HEAD
	bool "Generate melis head"
	default y
	help
		general epos_hdr head.

menu "Toolchain Setup"

config TOOLCHAIN_MACH_FLAGS
    string "Toolchain arch flags"
	default ""
	help
		Toolchain Arch Flags

config TOOLCHAIN_LD_FLAGS
    string "Toolchain ld flags"
	default ""
	help
		Toolchain LD Flags

endmenu

endmenu
```

## Software/BSP/e907_rtos/rtos/source/Kconfig.platform
```kconfig
menu "Platform Setup"

choice
	prompt "Chip select"

	config SOC_SUN20IW3P1
		bool "V853 E907 SOC Platform"
		select SOC_SUN20IW3
		help
			V853 E907 RTOS

endchoice

config SOC_SUN20I
	bool
	default n
	help
		Based on RISCV SOC familiy.

config SOC_SUN20IW3
	bool
	select SOC_SUN20I
	select ARCH_SUN20IW3
	help
		Based on SUN20I SOC familiy.

config ARCH_SUN20IW3
	bool
	help
		Based on SUN20I SOC familiy.

config DRAM_PHYBASE
	hex  "Physical base address of Dram"
	default 0x40000000 if SOC_SUN20I

config DRAM_VIRTBASE
	hex  "Virtual base address of Dram"
	default 0xc2000000 

config DRAM_SIZE
	hex  "Capacity of Dram"
	default 0x04000000
	help
		DDR physical memroy size.

config COHERENT_SIZE
	hex  "Capacity of NoCache Dram Zone"
	default 0x00c00000
	help
		Set Size Of NoCache Dram Zone for DMA etc

config COHERENT_START_ADDR
	hex  "Address of NoCache Dram Zone"
	default 0xa0000000
	help
		Set Start address of NoCache Dram Zone for DMA etc

config LOAD_DATA_TO_MEM_FROM_STORAGE
	bool  "load data to memory from storage"
	default y
	help
		the function used for more quickly reading when checking on fpg-board.

endmenu
```

## Software/BSP/e907_rtos/rtos/source/ekernel/Kconfig
```kconfig
menu "Kernel Setup"

source "ekernel/arch/Kconfig"
source "ekernel/core/Kconfig"
source "ekernel/drivers/drv/Kconfig"
source "ekernel/drivers/osal/Kconfig"
source "ekernel/drivers/test/Kconfig"
source "ekernel/subsys/Kconfig"

config ARMCPU_HIGH_VECTOR_ADDRESS
	bool  "USE HIGH Exception Vector Address"
	default y
	help
	if y, the exception vector would be located 0xffff0000
	else would be 0.

config IOREGS_VBASE
	hex  "Virtual base address of IO Register"
	default 0xf0000000

config SRAM_VBASE
	hex  "Virtual base address of Sram"
	default 0xf0000000

config CLK_TUNING_VBASE
	hex  "clk tunning code and data running address."
	default 0xffff2000

choice
	prompt "Rootfs Filesystem Type"
	default ROOTFS_LITTLEFS

    config ROOTFS_LITTLEFS
		bool "ARM Littlefs Filesystem"
		depends on RT_USING_DFS

	config ROOTFS_MINFS
	depends on MINFS
		bool "Allwinner Minfs Filesystem"

	config ROOTFS_FATFS
		bool "Fat Filesystem"

endchoice

config  CHANGE_COMPRESS_METHOD
	bool "change compress method of epos"
	default n

if CHANGE_COMPRESS_METHOD
	choice
		prompt "method of compress"
		help
			The higher the compression rate, the higher the decompression time.
			Compression rate sorting: LZMA > GZ > LZ4 > without compress.
			Decompression time sorting  at startup: LZMA > GZ > LZ4 > without compress.

		config EPOS_COMPRESS_LZMA
			bool "Epos compress with LZMA(default)"
			help
				If you want smaller firmware, LZMA compression is recommended.

		config EPOS_COMPRESS_GZ
			bool "Epos compress with GZ(recommend)"
			help
				GZ is the best compression algorithm considering both time and size

		config EPOS_COMPRESS_LZ4
			bool "Epos compress with LZ4(Fastest)"
			help
				If you want the Fastest boot speed, lz4 compression is recommended.

		config EPOS_COMPRESS_NONE
			bool "Epos without compress(The worst)"
			help
				Although there is no compression, we do not need to decompress the data, but we need more time to load the data.
	endchoice
endif

config DOUBLE_FREE_CHECK
	bool  "Doule Free Check"
	default n

endmenu
```

## Software/BSP/e907_rtos/rtos/source/ekernel/arch/Kconfig
```kconfig
menu "ARCH Support"

config  RISCV
	bool "Support riscv ISA processors"
	default y

if RISCV
source "ekernel/arch/riscv/Kconfig"
endif

endmenu
```

## Software/BSP/e907_rtos/rtos/source/ekernel/arch/riscv/Kconfig
```kconfig
menu "RISC-V ARCH Setup"

config SUPPORT_FP_KERNEL
	bool  "kernel compiled with/without 'fd' flag, AKA vfp support"
	default n
	depends on RISCV
	help
		kernel compiled with/without 'fd' flag, AKA vfp support"

choice
    prompt "RISCV bit mode"
	default RV32

config RV32
	bool  "CPU Support rv32bit ISA"
	depends on RISCV
	help
		processor supports rv32bit mode.
endchoice

config RV_MACHINE_MODE
	bool "Kernel Run In Machine Mode"
	depends on RISCV
	default n

config RV_CLINT
	bool "Kernel CLINT Driver"
	depends on RISCV
	default n

config CPU_DCACHE_DISABLE
    bool  "Disable RISCV CPU Dcache"
	default n
	depends on RISCV
	help
		Disable RISCV CPU Dcache.

config ARCH_RISCV_FPU
    bool  "CPU Support FPU"
	default n
	depends on RISCV
	help
		CPU Spuuort RISCV FPU.

choice
	prompt "Selete Float Point Format"
	default FPU_DOUBLE
config FPU_FLOAT
	bool "Use Singal float"
	depends on ARCH_RISCV_FPU
config FPU_DOUBLE
	bool "Use Double float"
	depends on ARCH_RISCV_FPU
endchoice

source "ekernel/arch/riscv/sunxi/Kconfig"

endmenu
```

## Software/BSP/e907_rtos/rtos/source/ekernel/arch/riscv/sunxi/Kconfig
```kconfig
menu "Sunxi Platform Support"

menuconfig CPUFREQ_SUPPORT
	bool "cpufreq support"
	default n
	help
		support cpufreq module.

if CPUFREQ_SUPPORT

source "ekernel/arch/riscv/sunxi/sun20iw3/Kconfig"

endif

endmenu
```

## Software/BSP/e907_rtos/rtos/source/ekernel/arch/riscv/sunxi/sun20iw3/Kconfig
```kconfig
config E907_CPUFREQ
	bool "E907 cpufreq"
	default n
	help
		Enable e907 cpufreq.
```

## Software/BSP/e907_rtos/rtos/source/ekernel/components/Kconfig
```kconfig
menu "Components Support"

source "ekernel/components/thirdparty/Kconfig"
source "ekernel/components/aw/Kconfig"

endmenu
```

## Software/BSP/e907_rtos/rtos/source/ekernel/components/aw/Kconfig
```kconfig
menu "Allwinner Components Support"

config SUBSYS_KGDB
    bool "kgdb sutb"
    default n
    help
        The is kgdb stub program, which work as gdbserver.

source "ekernel/components/aw/multi_console/Kconfig"

source "ekernel/components/aw/rpbuf/Kconfig"

source "ekernel/components/aw/virt_log/Kconfig"

source "ekernel/components/aw/samples/Kconfig"

source "ekernel/components/aw/standby/Kconfig"

source "ekernel/components/aw/debug/Kconfig"

source "ekernel/components/aw/waitqueue/Kconfig"

source "ekernel/components/aw/newlib/Kconfig"
endmenu
```

## Software/BSP/e907_rtos/rtos/source/ekernel/components/aw/newlib/Kconfig
```kconfig
menu "Libc library"

    choice
    prompt "C library"
    default LIBCNEWLIB

    config  LIBCNEWLIB
	    bool "newlib "

    config  LIBCNONE
	    bool "none"
    endchoice

endmenu
```
