## Software/BSP/e907_rtos/rtos/source/ekernel/components/aw/samples/Kconfig
```kconfig
menuconfig SUBSYS_SAMPLES
    bool "Samples Test"
    default n
    help
      compile components samples to test. 

if SUBSYS_SAMPLES

comment "Enable components samples that you want to run"

config COROUTINE_TEST
    bool "Coroutine Test"
    default n
    depends on KERNEL_SAMPLE_TEST
    help
       Run a coroutine test. 

config HELLO_TEST
    bool "hello Test to try"
    default n
    depends on SUBSYS_SAMPLES
    help
       It is used to test all situations.

config SYSCALL_TEST
    bool "system call test"
    default n
    depends on SUBSYS_SAMPLES
    help
       It is used to test systemcall interface.

config ZEPHYROS_TEST
    bool "zephyr os test case"
    default n
    depends on SUBSYS_SAMPLES
    help
       It is used to test zephyr os system api.

config RTTOS_TEST
    bool "rt-thread os test case"
    default n
    depends on SUBSYS_SAMPLES
    help
       It is used to test rt-thread os system api.

config SAMPLE_WAITQUEUE
    bool "Waitqueue Test"
	default n

config SAMPLE_TLBTEST
    bool "Tlb Test"
	default n

config SAMPLE_VFP_TEST
    bool "Vfp Test"
	default n

config SAMPLE_CPP_TEST
    bool "Cpp Test"
	default n

config SAMPLE_PRINHERIT_TEST
    bool "Prinherit Test"
	default n

config SAMPLE_GROUP_OBJS_TEST
    bool "Group Objs Test"
	default n

config SAMPLE_LIBRARY_TEST
    bool "Library Test"
	default n

config SAMPLE_YIELDIRQ_TEST
    bool "YieldIRQ Test"
	default n

config SAMPLE_YIELDLOCK_TEST
    bool "YieldLock Test"
	default n

config SAMPLE_SCANF_TEST
    bool "Scanf Test"
	default n

config SAMPLE_THUMB_TEST
    bool "Thumb Test"
	default n

config SAMPLE_COMPLETION_TEST
    bool "Completion Test"
	default n

config SAMPLE_PIPE_TEST
    bool "Pipe Test"
	default n

config SAMPLE_MKFIFO_TEST
    bool "Mkfifo Test"
	default n

config SAMPLE_TIMEVAL_TEST
    bool "Timeval Test"
	default n

config SAMPLE_KTIME_TEST
    bool "Ktime Test"
	default n

config SAMPLE_PRODUCER_TEST
    bool "Producer Test"
	default n

config SAMPLE_ARMEABI_TEST
    bool "ArmEabi Test"
	default n

config SAMPLE_STRICTPROTO_TEST
    bool "Strictproto Test"
	default n

config SAMPLE_NEON_TEST
    bool "Neon Test"
	default n

config SAMPLE_LDREX_TEST
    bool "Ldrex Test"
	default n

config SAMPLE_DMA_COHERENT_TEST
    bool "Dma Coherent Test"
	default n

config SAMPLE_ENUM_TEST
    bool "Enum Test"
	default n

config SAMPLE_ALLOCA_TEST
    bool "Alloca Test"
	default n

config SAMPLE_FILESYSTEM_TEST
    bool "Filesystem Test"
	default n

if SAMPLE_FILESYSTEM_TEST
source "ekernel/components/aw/samples/filesystem/Kconfig"
endif

config SAMPLE_LED_TEST
    bool "LED Test"
	default n

config SAMPLE_OSAL_TEST
	bool "OSAL Test"
	default n

config SAMPLE_CPU_CLK_TEST
    bool "Get Cpu and Ddr ClocK Test"
	default n

config SAMPLE_MMTEST
    bool "Sample Test"
	default n

config SAMPLE_MMUPROTECT
    bool "Sample MMU Protect Test"
	default n

config SAMPLE_MODS
    bool "Mod Test"
	default n

config SAMPLE_PTHREAD
    bool "Pthread Test"
	default n

config SAMPLE_CACHE_TEST
    bool "Cache Test"
	default n

config SAMPLE_EXCEPTION_TEST
    bool "Exception Test"
	default n

endif #SUBSYS_SAMPLES
```

## Software/BSP/e907_rtos/rtos/source/ekernel/components/aw/samples/filesystem/Kconfig
```kconfig
menu "FileSystem Tests"

config RAMFS_FAT_TEST
    bool "Set fat filesystem as ramfs"
    default n
    depends on SAMPLE_FILESYSTEM_TEST
    depends on FAT
    depends on MELIS_LAYERFS
    help
       mount ramfs at /mnt/E with fat filesystem.

if RAMFS_FAT_TEST
config RAMFS_FAT_TEST_SIZE
    hex "Ramfs fat filesystem size"
    default 0x800000
    help
        "set ramfs filesystem size, it will allocate an equal amount of memory"
endif

config FTRUNCATE_TEST
    bool "ftruncate test"
    default n
    help
       "ftruncate test"

config LSEEK_TEST
    bool "lseek test"
    default n
    help
       "lseek test"
endmenu
```

## Software/BSP/e907_rtos/rtos/source/ekernel/components/aw/samples/kconfig/Kconfig
```kconfig
choice
	prompt "kconfig test select"
	default KCONFIG_CHOICE_ITEM3

	config KCONFIG_CHOICE_ITEM1
		bool "kernel config choice item1"
		help
			kernel config choice item1

	config KCONFIG_CHOICE_ITEM2
		bool "kernel config choice item2"
		help
			kernel config choice item2

	config KCONFIG_CHOICE_ITEM3
		bool "kernel config choice item3"
		help
			kernel config choice item3

	config KCONFIG_CHOICE_ITEM4
		bool "kernel config choice item4"
		help
			kernel config choice item4

	config KCONFIG_CHOICE_ITEM5
		bool "kernel config choice item5"
		help
			kernel config choice item5
endchoice

config KCONFIG_COMMON_CONFIG1
	#bool "kernel common config 1"
	default n
	help
		kernel common config 1

config KCONFIG_COMMON_CONFIG2
	#bool "kernel common config 2"
	default n
	help
		kernel common config 2

config KCONFIG_COMMON_CONFIG3
	#bool "kernel common config 3"
	default n
	help
		kernel common config 3

source "ekernel/components/samples/kconfig/internal/Kconfig"
```

## Software/BSP/e907_rtos/rtos/source/ekernel/components/aw/samples/kconfig/internal/Kconfig
```kconfig
choice
	prompt "kconfig test select"
	default KCONFIG_INTERNAL_CHOICE_ITEM5

	config KCONFIG_INTERNAL_CHOICE_ITEM1
		bool "kernel internal config choice item1"
		help
			kernel internal config choice item1

	config KCONFIG_INTERNAL_CHOICE_ITEM2
		bool "kernel internal config choice item2"
		help
			kernel internal config choice item2

	config KCONFIG_INTERNAL_CHOICE_ITEM3
		bool "kernel internal config choice item3"
		help
			kernel internal config choice item3

	config KCONFIG_INTERNAL_CHOICE_ITEM4
		bool "kernel internal config choice item4"
		help
			kernel internal config choice item4

	config KCONFIG_INTERNAL_CHOICE_ITEM5
		bool "kernel internal config choice item5"
		select KCONFIG_COMMON_CONFIG3
		help
			kernel internal config choice item5
endchoice

config KCONFIG_INTERNAL_COMMON_CONFIG1
	bool "kernel internal common config 1"
	default n
	help
		kernel internal common config 1

config KCONFIG_INTERNAL_COMMON_CONFIG2
	bool "kernel internal common config 2"
	default n
	help
		kernel internal common config 2

config KCONFIG_INTERNAL_COMMON_CONFIG3
	bool "kernel internal common config 3"
	default n
	help
		kernel internal common config 3
```

## Software/BSP/e907_rtos/rtos/source/ekernel/components/aw/standby/Kconfig
```kconfig
menuconfig STANDBY
	def_bool n
	prompt "standby support"

menuconfig STANDBY_MSGBOX
	bool "standby-msgbox support"
	default n
	depends on DRIVERS_MSGBOX_AMP && ARCH_SUN20IW3
	select STANDBY
	help
		The function depend on msgbox-driver.
		Currently,only support e907.

if STANDBY_MSGBOX

comment "standby config"

config STANDBY_MSGBOX_CHANNEL
	int "msgbox channel"
	range 0 3
	default 1
	help
		selete which msbox channel used by standby.

config STANDBY_MSGBOX_IRQ
	int "msgbox irq number"
	default 144

endif
```

## Software/BSP/e907_rtos/rtos/source/ekernel/components/aw/virt_log/Kconfig
```kconfig
menuconfig VIRT_LOG
	bool "virtual log"
	default n

if VIRT_LOG
config VIRT_LOG_SIZE
	int "virt log buffer size(unit:Kb)"
	default 4
endif
```

## Software/BSP/e907_rtos/rtos/source/ekernel/components/aw/waitqueue/Kconfig
```kconfig
config COMPONENTS_WAITQUEUE
	bool "AW WaitQueue Support"
	default n
	help
	  Support Allwinner WaitQueue.
```

## Software/BSP/e907_rtos/rtos/source/ekernel/components/thirdparty/Kconfig
```kconfig
menu "Thirdparty Components Support"

source "ekernel/components/thirdparty/dfs/Kconfig"
source "ekernel/components/thirdparty/openamp/Kconfig"
source "ekernel/components/thirdparty/cplusplus/Kconfig"
source "ekernel/components/thirdparty/finsh_cli/Kconfig"
source "ekernel/components/thirdparty/archival/Kconfig"
source "ekernel/components/thirdparty/pthreads/Kconfig"
source "ekernel/components/thirdparty/benchmark/Kconfig"
source "ekernel/components/thirdparty/decompress/Kconfig"
source "ekernel/components/thirdparty/mmap/Kconfig"

endmenu
```

## Software/BSP/e907_rtos/rtos/source/ekernel/components/thirdparty/archival/Kconfig
```kconfig
menu "archival support"

config SUBSYS_ARCHIVAL
    bool "Enable Archival Support"
    default y

endmenu
```

## Software/BSP/e907_rtos/rtos/source/ekernel/components/thirdparty/benchmark/Kconfig
```kconfig
menuconfig BENCHMARK
    bool "BenchMark Test Support"
    default n
    help
        benchmark test for cpu evolution.
```

## Software/BSP/e907_rtos/rtos/source/ekernel/components/thirdparty/cplusplus/Kconfig
```kconfig
menuconfig CXX
    bool "CXX Support"
    default n
    help
        Support CXX compile.
```

## Software/BSP/e907_rtos/rtos/source/ekernel/components/thirdparty/decompress/Kconfig
```kconfig
menuconfig KERNEL_COMPRESS
	bool "Compress Support"
	default n

if KERNEL_COMPRESS
config KERNEL_COMPRESS_DEBUG
	bool "Debug"
	default n

choice
	prompt "Compress kernel format"
	config KERNEL_COMPRESS_ELF
	bool "elf"
	config KERNEL_COMPRESS_BIN
	bool "bin"
endchoice

if KERNEL_COMPRESS_ELF
config KERNEL_COMPRESS_LOADADDR
	hex "ELF decompress addr"
	default 0
	help
		if =0,will auto select load addr
endif

choice
	prompt "Compress methon"
	config KERNEL_COMPRESS_GZIP
		bool "GZIP"
	config KERNEL_COMPRESS_LZO
		bool "LZO"
	config KERNEL_COMPRESS_LZMA
		bool "LZMA"
	config KERNEL_COMPRESS_XZ
		bool "XZ"
		select XZ_DEC_BCJ
		select XZ_DEC_RISCV if RISCV
		select XZ_DEC_ARM if ARM
	config KERNEL_COMPRESS_LZ4
		bool "LZ4"
endchoice
endif
```
