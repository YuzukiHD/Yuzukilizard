## Software/BSP/e907_rtos/rtos/source/ekernel/drivers/drv/Kconfig
```kconfig
# Kconfig - general configuration options

#
# Copyright (c) 2014-2015 Wind River Systems, Inc.
# Copyright (c) 2016 Intel Corporation
#
# Licensed under the Apache License, Version 2.0 (the "License");
# you may not use this file except in compliance with the License.
# You may obtain a copy of the License at
#
#     http://www.apache.org/licenses/LICENSE-2.0
#
# Unless required by applicable law or agreed to in writing, software
# distributed under the License is distributed on an "AS IS" BASIS,
# WITHOUT WARRANTIES OR CONDITIONS OF ANY KIND, either express or implied.
# See the License for the specific language governing permissions and
# limitations under the License.
#

menu "Drivers Setup"
	config  UART_BAUD_RATE
		int "uart baud rate"
		default 115200
		range 9600 115200

if DRIVER_SDMMC
	config SUPPORT_SDMMC_CACHE
		bool "support sdmmc cache"
		default n
		help
			"Add Sdmmc Cache Layer For Write Small Files"

	config SDMMC_CACHE_SIZE
		int "sdmmc cache size (KB)"
		default 1024
		depends on SUPPORT_SDMMC_CACHE
		help
			"Configure Sdmmc Cache Heap Size"

	config SDMMC_CACHE_WRITEBACK_THREAD_PRIO
		int "sdmmc cache writeback thread priority"
		default 14
		depends on SUPPORT_SDMMC_CACHE
		help
			"Configure Sdmmc Cache Writeback Thread Priority"

	config SDMMC_CACHE_INFO_CMD
		bool "support sdmmc cache information command"
		default n
		depends on SUPPORT_SDMMC_CACHE
		help
			"Add Sdmmc Cache Information Command"
endif

	source "ekernel/drivers/drv/source/Kconfig"

	menu "SoC HAL Drivers"
	source "ekernel/drivers/rtos-hal/hal/source/common/Kconfig"
	source "ekernel/drivers/rtos-hal/hal/source/ccmu/Kconfig"
	source "ekernel/drivers/rtos-hal/hal/source/uart/Kconfig"
	source "ekernel/drivers/rtos-hal/hal/source/gpio/Kconfig"
	source "ekernel/drivers/rtos-hal/hal/source/dma/Kconfig"
	source "ekernel/drivers/rtos-hal/hal/source/twi/Kconfig"
	source "ekernel/drivers/rtos-hal/hal/source/spi/Kconfig"
	source "ekernel/drivers/rtos-hal/hal/source/pwm/Kconfig"
	source "ekernel/drivers/rtos-hal/hal/source/gpadc/Kconfig"
	source "ekernel/drivers/rtos-hal/hal/source/msgbox/Kconfig"
	endmenu

endmenu
```

## Software/BSP/e907_rtos/rtos/source/ekernel/drivers/drv/source/Kconfig
```kconfig
menu "Melis Source Support"

config  DRIVER_GPIO
        bool "Support GPIO Driver"
        default y

config  DRIVER_TWIBUS
        bool "Support i2c bus Driver"
        default y

config  DRIVER_PWM
        bool "Support pwm Driver"
        default y

config  DRIVER_SERIAL
	bool "Support Serial Driver"
	default y

config  DRIVER_DMA
	bool "Support DMA Driver"
	default y

config  DRIVER_CCMU
	bool "Support CCMU Driver"
	default y

config  DRIVER_NAND_FLASH
	bool "Support Nand Flash Driver"
	default n

menu "adc select"
	depends on DRIVER_ADC_POWER

source "ekernel/drivers/drv/source/adc_power/Kconfig"

endmenu

endmenu
```

## Software/BSP/e907_rtos/rtos/source/ekernel/drivers/drv/source/adc_power/Kconfig
```kconfig
config POWER_GPADC_SECLET
	bool "power use gpadc"
	default n 
	---help---

config POWER_TPADC_SECLET
	bool  "power use tpadc"
	default n
	---help---
```

## Software/BSP/e907_rtos/rtos/source/ekernel/drivers/drv/source/ram_dev/Kconfig
```kconfig
menu "Ramfs Device Support"

config  RAMFS_DEVICE
        bool "Support Ramfs Device"
        default n

if RAMFS_DEVICE
config  RAMFS_DEVICE_SIZE
        hex "Ramfs Device Size"
        default 0x1000000
        help
            "set ramfs device size for ramfs"

config  RAMFS_DEVICE_NAME
        string "Ramfs Device Name"
        default "ram"
        help
            "set ramfs device name"

config  RAMFS_TYPE
        string "Ramfs Type"
        default "lfs"
        help
            "set ramfs type"

config  RAMFS_MOUNT_PATH
        string "Ramfs Mount Path"
        default "/tmp"
        help
            "set ramfs mount path"
endif

endmenu
```

## Software/BSP/e907_rtos/rtos/source/ekernel/drivers/osal/Kconfig
```kconfig
menu "Osal Setup"

config DRIVER_OSAL_CFG
    bool "Osal Config"
    default y
	help
		config interface for sys_config.fex

if DRIVER_OSAL_CFG
	config SYSCONF_BUILDIN
		bool "sys_config.bin build in kernel image."
		default n
endif

endmenu
```

## Software/BSP/e907_rtos/rtos/source/ekernel/drivers/test/Kconfig
```kconfig
# Kconfig - general configuration options

#
# Copyright (c) 2014-2015 Wind River Systems, Inc.
# Copyright (c) 2016 Intel Corporation
#
# Licensed under the Apache License, Version 2.0 (the "License");
# you may not use this file except in compliance with the License.
# You may obtain a copy of the License at
#
#     http://www.apache.org/licenses/LICENSE-2.0
#
# Unless required by applicable law or agreed to in writing, software
# distributed under the License is distributed on an "AS IS" BASIS,
# WITHOUT WARRANTIES OR CONDITIONS OF ANY KIND, either express or implied.
# See the License for the specific language governing permissions and
# limitations under the License.

menu "Drivers Test Sample"

    config  SUNXI_PWM_TEST
        bool "Pwm Test"
        default n

    config  SUNXI_GPIO_TEST
        bool "Gpio Test"
        default n

    config  SUNXI_TWI_TEST
        bool "Twi Test"
        default n

    config  SUNXI_RTC_TEST
        bool "Rtc Test"
        default n

    config  SUNXI_UART_TEST
        bool "Uart Test"
        default n

    config SUNXI_STANDBY_TEST
        bool "standby test"
        default n
endmenu
```

## Software/BSP/e907_rtos/rtos/source/ekernel/subsys/Kconfig
```kconfig
menu "Subsystem support"

config CMSIS
    bool "ARM CMSIS interface support"
    default n
    help
       CMSIS enables consistent device support and simple software interfaces to the processor and its peripherals, simplifying software reuse, reducing the learning curve for microcontroller developers, 
       and reducing the time to market for new devices.

config PTHREAD
    bool "Posix Thread Support"
    default n
    help
        Allow pthread_xxx interface to develop application.

config CXX
    bool "CXX Support"
    default n
    help
        Support CXX compile.

config BENCHMARK
    bool "BenchMark Test Support"
    default n
    help
        benchmark test for cpu evolution.

config DEBUG_BACKTRACE
    bool "Enable Backtrace Support"
    default y

config SUBSYS_ARCHIVAL
    bool "Enable Archival Support"
    default y

menu "Libc library"
    choice
    prompt "C library"
    default LIBCNEWLIB

    config  LIBCNEWLIB
	    bool "newlib "

    config  LIBCNONE
	    bool "none"
    endchoice

config EXTERN_LIBC
    bool
    default n if LIBCNONE
    default y if LIBCNEWLIB

config LIBC_MMAP
    bool "mmap"
	default y

endmenu

menuconfig KERNEL_COMPRESS
	bool "Compress Support"
	default n

if KERNEL_COMPRESS
config KERNEL_COMPRESS_DEBUG
	bool "Debug"
	default n

choice
	prompt "Compress kernel format"
	config KERNEL_COMPRESS_ELF
	bool "elf"
	config KERNEL_COMPRESS_BIN
	bool "bin"
endchoice

if KERNEL_COMPRESS_ELF
config KERNEL_COMPRESS_LOADADDR
	hex "ELF decompress addr"
	default 0
	help
		if =0,will auto select load addr
endif

choice
	prompt "Compress methon"
	config KERNEL_COMPRESS_GZIP
		bool "GZIP"
	config KERNEL_COMPRESS_LZO
		bool "LZO"
	config KERNEL_COMPRESS_LZMA
		bool "LZMA"
	config KERNEL_COMPRESS_XZ
		bool "XZ"
		select XZ_DEC_BCJ
		select XZ_DEC_RISCV if RISCV
		select XZ_DEC_ARM if ARM
	config KERNEL_COMPRESS_LZ4
		bool "LZ4"
endchoice
endif

source "ekernel/subsys/samples/Kconfig"
source "ekernel/subsys/config/Kconfig"
source "ekernel/subsys/thirdparty/Kconfig"
source "ekernel/subsys/aw/Kconfig"
source "ekernel/subsys/finsh_cli/Kconfig"
source "ekernel/subsys/cplusplus/Kconfig"
source "ekernel/subsys/standby/Kconfig"

endmenu
```

## Software/BSP/e907_rtos/rtos/source/ekernel/subsys/aw/Kconfig
```kconfig
menu "Allwinner Components Support"

config BLKPART_SHOW_INFO_CMD
    bool "blkpart information cmd"
    default n
    help
        Show All partitions information

source "ekernel/subsys/aw/multi_console/Kconfig"

source "ekernel/subsys/aw/rpbuf/Kconfig"

source "ekernel/subsys/aw/virt_log/Kconfig"

endmenu
```

## Software/BSP/e907_rtos/rtos/source/ekernel/subsys/aw/multi_console/Kconfig
```kconfig
menu "AW Multi-Console Compenents"

config SUBSYS_MULTI_CONSOLE
    bool "Melis Multi Console"
    default y
    help
        Melis Multi Console Support.
        If unsure, say N.

if SUBSYS_MULTI_CONSOLE

config MULTI_CONSOLE_DEBUG
    bool "Melis Multi-Console Debug"
    default n
    help
        Melis Multi-Console Debug.

config MULTI_CONSOLE_REDIRECT_CMD
    bool "Melis Multi-Console Redirect Command"
    default n
    help
        Melis Multi-Console Redirece Command.

config MULTI_CONSOLE_RPMSG
    bool "Support multi-Console by rpmsg"
    default n
    depends on SUPPORT_AMP
    help
        Support multi-Console by rpmsg.
        Depend on openamp compenents.

endif

endmenu
```

## Software/BSP/e907_rtos/rtos/source/ekernel/subsys/aw/rpbuf/Kconfig
```kconfig
menu "RPBuf framework"

config COMPONENTS_RPBUF
	bool
	help
	  The RPBuf (Remote Processor Buffer) framework provides mechanisms to
	  allocate buffers and transmit their references to remote processor.
	  This allows user to exchange large data with remote processor.

config COMPONENTS_RPBUF_SERVICE_RPMSG
	bool "RPMsg-based RPBuf service component"
	select COMPONENTS_RPBUF
	select SUPPORT_AMP
	help
	  Say y here to enable support for the RPMsg-based RPBuf service component.
	  This is one kind of RPBuf service backend implemented with RPMsg.

config COMPONENTS_RPBUF_CONTROLLER
	bool "RPBuf controller component"
	select COMPONENTS_RPBUF
	help
	  Say y here to enable support for the RPBuf controller component.

config COMPONENTS_RPBUF_RPMSG_DEMO
	bool "RPMsg-based RPBuf service component demo"
	select COMPONENTS_RPBUF
	select SUPPORT_AMP
	help
	  Say y here to enable support for the RPBuf rpmsg demo.


endmenu
```

## Software/BSP/e907_rtos/rtos/source/ekernel/subsys/config/Kconfig
```kconfig
menu "devicetree support"

config OF
    bool "support devicetree runtime configuration or not"
    default n

config FEXCONFIG
    bool "support traditional fex configuration method parser."
    default y

endmenu
```

## Software/BSP/e907_rtos/rtos/source/ekernel/subsys/finsh_cli/commands/iobox/Kconfig
```kconfig
menu "Iobox Command"

    config  IOBOX_TAIL
        bool "Tail command"
        default n

    config  IOBOX_TOUCH
        bool "Touch command"
        default n

    config  IOBOX_GREP
        bool "Grep command"
        default n

    config  IOBOX_HEXDUMP
        bool "Hexdump command"
        default y

    config  IOBOX_LS
        bool "Ls command"
        default y

    config  IOBOX_RM
        bool "Rm command"
        default y

    config  IOBOX_RWCHECK
        bool "Rwcheck command"
        default n

    config  IOBOX_RWSPEED
        bool "Rwspeed command"
        default n

    config  IOBOX_RSPEED
        bool "Rspeed command"
        default n

    config  IOBOX_WSPEED
        bool "Wspeed command"
        default n

    config  IOBOX_MOUNT
        bool "Mount command"
        default n

endmenu
```
