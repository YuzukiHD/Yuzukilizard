## Software/BSP/e907_rtos/rtos/source/ekernel/components/thirdparty/devicetree/Kconfig
```kconfig
config OF
    bool "support devicetree runtime configuration or not"
    default n
```

## Software/BSP/e907_rtos/rtos/source/ekernel/components/thirdparty/dfs/Kconfig
```kconfig
menu "RT-Thread DFS Support"

config RT_USING_DFS
    bool "rt-thread dfs virtual file system"
    select RT_USING_MUTEX
    default y
    help
        The device file system is a light weight virtual file system.

if RT_USING_DFS
    config DFS_USING_WORKDIR
        bool "Using working directory"
        default y

    config DFS_FILESYSTEMS_MAX
        int "The maximal number of mounted file system"
        default 4 if RT_USING_DFS_NFS
        default 2

    config DFS_FILESYSTEM_TYPES_MAX
        int "The maximal number of file system type"
        default 4 if RT_USING_DFS_NFS
        default 2

    config DFS_FD_MAX
        int "The maximal number of opened files"
        default 16

    config RT_USING_DFS_MNTTABLE
        bool "Using mount table for file system"
        default n
        help
            User can use mount table for automatically mount, for example:
                const struct dfs_mount_tbl mount_table[] =
                {
                    {"flash0", "/", "elm", 0, 0},
                    {0}
                };
            The mount_table must be terminated with NULL.

    config RT_USING_DFS_ELMFAT
        bool "Enable elm-chan fatfs"
        default n
        help
            FatFs is a generic FAT/exFAT file system module for small embedded systems.

    if RT_USING_DFS_ELMFAT
        menu "elm-chan's FatFs, Generic FAT Filesystem Module"
        config RT_DFS_ELM_CODE_PAGE
            int "OEM code page"
            default 437

        config RT_DFS_ELM_WORD_ACCESS
            bool "Using RT_DFS_ELM_WORD_ACCESS"
            default y

        choice
            prompt "Support long file name"
            default RT_DFS_ELM_USE_LFN_3

            config RT_DFS_ELM_USE_LFN_0
                bool "0: LFN disable"

            config RT_DFS_ELM_USE_LFN_1
                bool "1: LFN with static LFN working buffer"

            config RT_DFS_ELM_USE_LFN_2
                bool "2: LFN with dynamic LFN working buffer on the stack"

            config RT_DFS_ELM_USE_LFN_3
                bool "3: LFN with dynamic LFN working buffer on the heap"
        endchoice

        config RT_DFS_ELM_USE_LFN
            int
            default 0 if RT_DFS_ELM_USE_LFN_0
            default 1 if RT_DFS_ELM_USE_LFN_1
            default 2 if RT_DFS_ELM_USE_LFN_2
            default 3 if RT_DFS_ELM_USE_LFN_3

        config RT_DFS_ELM_MAX_LFN
            int "Maximal size of file name length"
            range 12 255
            default 255

        config RT_DFS_ELM_DRIVES
            int "Number of volumes (logical drives) to be used."
            default 2

        config RT_DFS_ELM_MAX_SECTOR_SIZE
            int "Maximum sector size to be handled."
            default 512
            help
                if you use some spi nor flash for fatfs, please set this the erase sector size, for example 4096.

        config RT_DFS_ELM_USE_ERASE
            bool "Enable sector erase feature"
            default n

        config RT_DFS_ELM_REENTRANT
            bool "Enable the reentrancy (thread safe) of the FatFs module"
            default y
        endmenu
    endif

    config RT_USING_DFS_DEVFS
        bool "Using devfs for device objects"
        default y

    config RT_USING_DFS_LITTLEFS
        bool "Enable Little file system"
        default y

    config RT_USING_DFS_ROMFS
        bool "Enable ReadOnly file system on flash"
        default n

    config RT_USING_DFS_RAMFS
        bool "Enable RAM file system"
        select RT_USING_MEMHEAP
        default n

if RT_USING_DFS_RAMFS
	config RT_USING_DFS_RAMFS_PATH
        string "Ramfs mount path"
        depends on RT_USING_DFS_RAMFS
        default "/tmp"
        help
            "set ramfs mount path for system"

    config RAMFS_SYSTEM_HEAP
        bool "Use system heap"
        default n
        depends on RT_USING_DFS_RAMFS
        help
            "use system heap rather than independent heap to reduce memory usage"

    config RT_USING_DFS_RAMFS_SIZE
        hex "Ramfs filesystem size"
        depends on RT_USING_DFS_RAMFS
        default 0x800000
        help
            "set ramfs filesystem size for system, it will allocate an equal amount of memory"

	config RT_USING_DFS_RAMFS_SUPPORT_DIRECTORY
        bool "Ramfs support directory"
        depends on RT_USING_DFS_RAMFS
        default y
        help
            "support directory for ramfs filesystem by Allwinner"

    config RT_USING_DFS_RAMFS_DATA_SLICE
        bool "Ramfs data slice"
        depends on RT_USING_DFS_RAMFS
        default y
        help
            "support data slice for ramfs filesystem by Allwinner"

endif

    config MELIS_LAYERFS
        bool "Mount Melis FS AS Dir in DFS"
        depends on MELIS_VIRTUAL_FILESYSTEM
        default y

if MELIS_LAYERFS
        source "ekernel/components/thirdparty/dfs/filesystems/layerfs/Kconfig"
endif

    config MELIS_LAYERFS_DIR_PATH
        string "Melis Layerfs Dir Path in DFS"
        default "/mnt/"
        depends on MELIS_LAYERFS

    config MELIS_ROOTFS
        bool "Mount Melis rootfs file system for root directory"
        default y

endif
endmenu
```

## Software/BSP/e907_rtos/rtos/source/ekernel/components/thirdparty/finsh_cli/Kconfig
```kconfig
menu "Command shell"

config RT_USING_FINSH
    bool "finsh shell"
    default y

if RT_USING_FINSH

config FINSH_THREAD_NAME
    string "The finsh thread name"
    default "tshell"
config FINSH_USING_HISTORY
    bool "Enable command history feature"
    default y
if FINSH_USING_HISTORY
config FINSH_HISTORY_LINES
    int "The command history line number"
    default 5
endif

config FINSH_USING_SYMTAB
    bool "Using symbol table for commands"
    default y

config FINSH_USING_DESCRIPTION
    bool "Keeping description in symbol table"
    default y

config FINSH_ECHO_DISABLE_DEFAULT
    bool "Disable the echo mode in default"
    default n
    
config FINSH_THREAD_PRIORITY
    int "The priority level value of finsh thread"
    default 20

config FINSH_THREAD_STACK_SIZE
    int "The stack size for finsh thread"
    default 4096

config FINSH_CMD_SIZE
    int "The command line size for shell"
    default 80

config FINSH_USING_AUTH
    bool "shell support authentication"
    default n

if FINSH_USING_AUTH
config FINSH_DEFAULT_PASSWORD
    string "The default password for shell authentication"
    default "rtthread"
config FINSH_PASSWORD_MIN
    int "The password min length"
    default 6
config FINSH_PASSWORD_MAX
    int "The password max length"
    default RT_NAME_MAX
endif

config FINSH_USING_MSH
    bool "Using module shell"
    default y

if FINSH_USING_MSH
config FINSH_USING_MSH_DEFAULT
    bool "Using module shell in default"
    default y

config FINSH_USING_MSH_ONLY
    bool "Only using module shell"
    default n

config FINSH_ARG_MAX
    int "The command arg num for shell"
    default 10
endif

if FINSH_USING_MSH
config FINSH_EXTERN_SCRIPT
    bool "Finsh client parse a external script"
    depends on SOC_SUN20IW1
    default n

config FINSH_EXTERN_SCRIPT_PATH
    string  "The external script path"
    depends on FINSH_EXTERN_SCRIPT
    default "/data/"
endif

endif

source "ekernel/components/thirdparty/finsh_cli/commands/Kconfig"

endmenu
```

## Software/BSP/e907_rtos/rtos/source/ekernel/components/thirdparty/finsh_cli/commands/Kconfig
```kconfig
menu "Commands"

    config  COMMAND_FORK
        bool "Fork Command"
        default y

    config  COMMAND_MEM_LAYOUT
        bool "Mem Layout Command"
        default n

    config  COMMAND_DATE
        bool "Date Command"
        default y

    config  COMMAND_EXIT
        bool "Exit Command"
        default y

    config  COMMAND_ADBD
		depends on COMPONENT_ADBD
        bool "Adbd Command"
        default y
	
    config  COMMAND_UPDATE
        bool "Update Command"
        default y

    config  COMMAND_MTPD
        bool "MTP Comand"
        depends on COMPONENT_MTP
        default y
	
    config  COMMAND_MTOP
        bool "Memory Bandwidth Comand"
        depends on DRIVERS_MBUS
        default n

    config  COMMAND_INSMOD
        bool "Insmod Comand"
        default y

    config  COMMAND_MEMTESTER
        bool "memtester"
        default n

    config  COMMAND_THERMAL
        bool "thermal"
        depends on DRIVER_THERMAL
        default y

	config  COMMAND_PQD
		bool "enable pq when power on"
		default n

    config  COMMAND_PQD_TEST
		depends on COMPONENT_ADBD && NETWORK && COMPONENTS_ADBD_SOCKETS && COMMAND_PQD
		bool "Pqd debug param"
		default n

    config  COMMAND_MMLK
        bool "mmlk"
        default y

    config  COMMAND_HELLOWORLD
        bool "helloworld Command"
        default n

    config  COMMAND_RTT_VERSION
        bool "version Command"
        default n

    config  COMMAND_WATCHDOG
        bool "watchdog Command"
        default n

    config  COMMAND_MMC_READ
        bool "mmc_read Command"
        default n

    config  COMMAND_MMC_WRITE
        bool "mmc_write Command"
        default n

    config  COMMAND_PRODUCT
        bool "getprop Command"
        default n

    config  COMMAND_BACKTRACE
        bool "backtrace Command"
        default y

    config  COMMAND_REBOOT
        bool "reboot Command"
        default y

    config  COMMAND_PANIC
        bool "panic Command"
        default y

    config  COMMAND_PRINT_MEM
        bool "p Command"
        default y

    config  COMMAND_WRITE_MEM
        bool "m Command"
        default y

    config  COMMAND_LISTIRQ
        bool "listirq Command"
        default n

    config  COMMAND_SLABINFO
        bool "slabinfo Command"
        default n

    config  COMMAND_UNAME
        bool "uname Command"
        default n

    config  COMMAND_CPUFREQ
        bool "cpufreq command"
        default n

source "ekernel/components/thirdparty/finsh_cli/commands/iobox/Kconfig"

endmenu
```

## Software/BSP/e907_rtos/rtos/source/ekernel/components/thirdparty/openamp/Kconfig
```kconfig
menu "OpenAMP Support"

config SUPPORT_LIBMETAL
	bool "Libmetal Support"
	default n

config SUPPORT_AMP
	bool "OpenAMP Framework Support"
	depends on SUPPORT_LIBMETAL && DRIVERS_MSGBOX
	default n

if SUPPORT_AMP
	config AMP_SLAVE_MODE
		bool "salve mode(current only support slave mode)"
		default y

	config MBOX_CHANNEL
		int "Using msgbox channel"
		range 0 7
		default 0

	config MBOX_QUEUE_LENGTH
		int "Config msgbox recv queue len"
		range 1 1024
		default 16

	config RPMSG_DEMO
		bool "rpmsg simple demo"
		default n

	config RPMSG_NOTIFY
		bool "rpmsg notify driver"
		default n

	config RPMSG_SPEEDTEST
		bool "rpmsg speedtest demo"
		default n

	config AMP_SHARE_IRQ
		bool "openamp share interrupts support"
		depends on SUPPORT_AMP
		default y
		help
		  Openamp share interrupts support

	menuconfig RPMSG_CLIENT
		bool "rpmsg client driver"
		default n
	if RPMSG_CLIENT
		config RPMSG_CLIENT_TEST
			bool "Export client test cmd"
			default n
		config RPMSG_CLIENT_QUEUE_SIZE
			int "rpmsg rx queue size"
			range 0 128
			default 16
		config RPMSG_CLIENT_DEBUG
			bool "printf debug info"
			default n
	endif

	menuconfig RPMSG_HEARBEAT
		bool "rpmsg hearbeat driver"
		default n
	if RPMSG_HEARBEAT
		config RPMSG_REMOTE_NAME
		string "remoteproc master name."
		default "e907_rproc"
		help
			remoteproc master name.
			it will be defined in device tree in major core.
			e.g e907_rproc@0 { ... }; is defined in dts.
			e907_rproc is the master name.
	endif

	config SLAVE_EARLY_BOOT
		bool "system will early boot before master rproc ready"
		default y

	config RPBUF_DEMO
		bool "RPBuf demo"
		default n
		select COMPONENTS_RPBUF
		help
		  This is a demo thar introduces how to use RPBuf to exchange large data
		  with remote processor.

	menuconfig AMP_TRACE_SUPPORT
		bool "openamp trace Support"
		default n
		select COMPONENTS_RPBUF
		help
		  This is a demo thar introduces how to use RPBuf to exchange large data
		  with remote processor.
	if AMP_TRACE_SUPPORT
	config AMP_TRACE_BUF_SIZE
		hex "config trace buffer size"
		default 0x1000
	endif
endif

endmenu
```

## Software/BSP/e907_rtos/rtos/source/ekernel/components/thirdparty/pthreads/Kconfig
```kconfig
menuconfig PTHREAD
    bool "Posix Thread Support"
    default n
    help
        Allow pthread_xxx interface to develop application.
```

## Software/BSP/e907_rtos/rtos/source/ekernel/core/Kconfig
```kconfig
menu "RTOS Kernel Setup"

choice
	prompt "RTOS Kernel Select"
	default RTTKERNEL

config  RTTKERNEL
	bool "Take RT-Thread as Melis Kernel"

endchoice

source "ekernel/core/rt-thread/Kconfig"
#source "ekernel/core/rt-thread/wrapper/Kconfig"

config HZ
	int "Tick frequency, Hz"
	range 10 1000
	default 1000 if ZEPHYRKERNEL
	default 100 if  RTTKERNEL
	help
	System's tick frequency, Hz.

config KERNEL_SAMPLE_TEST
	bool "rtos kernel sample test code"
	depends on RTTKERNEL || ZEPHYRKERNEL
	default n

endmenu
```

## Software/BSP/e907_rtos/rtos/source/ekernel/core/rt-thread/Kconfig.scheduler
```kconfig
config CONSISTENT_CONTEXT_SWITCH
    bool "take rt_schedule as interrupt preempt schedule entry point"
    default y    
    help         
    	this option will take `rt_schedule` as the totally solely schedule
	point of the whole system, except the trigger schedule from system
	bringup.
	this way something like linux implemtation, which use '__schedule' 
	as the solely schedule entry point of the kernel.

config NEST_INTERRUPT
	bool "Support interrupt nest or not."
	default y
	help
		This option would enable the nest interrupt mechanism.
```

## Software/BSP/e907_rtos/rtos/source/ekernel/core/zephyr/Kconfig
```kconfig
menu "Zephyr Kernel Setup"
depends on ZEPHYRKERNEL 

source "ekernel/core/zephyr/kernel/Kconfig"
source "ekernel/core/zephyr/misc/Kconfig"
source "ekernel/core/zephyr/subsys/Kconfig"

endmenu
```

## Software/BSP/e907_rtos/rtos/source/ekernel/core/zephyr/subsys/Kconfig
```kconfig
# Kconfig - Subsystem configuration options
#
# Copyright (c) 2016-2017 Intel Corporation
#
# SPDX-License-Identifier: Apache-2.0
#

source "ekernel/core/zephyr/subsys/bluetooth/Kconfig"

source "ekernel/core/zephyr/subsys/console/Kconfig"

source "ekernel/core/zephyr/subsys/cpp/Kconfig"

source "ekernel/core/zephyr/subsys/debug/Kconfig"

source "ekernel/core/zephyr/subsys/disk/Kconfig"

source "ekernel/core/zephyr/subsys/fs/Kconfig"

source "ekernel/core/zephyr/subsys/logging/Kconfig"

source "ekernel/core/zephyr/subsys/net/Kconfig"

source "ekernel/core/zephyr/subsys/shell/Kconfig"

source "ekernel/core/zephyr/subsys/usb/Kconfig"
```

## Software/BSP/e907_rtos/rtos/source/ekernel/core/zephyr/subsys/net/lib/Kconfig
```kconfig
#
# Copyright (c) 2016 Intel Corporation
#
# SPDX-License-Identifier: Apache-2.0
#

menu "Network Protocols"

source "ekernel/core/zephyr/subsys/net/lib/zoap/Kconfig"

source "ekernel/core/zephyr/subsys/net/lib/dns/Kconfig"

source "ekernel/core/zephyr/subsys/net/lib/mqtt/Kconfig"

source "ekernel/core/zephyr/subsys/net/lib/http/Kconfig"

source "ekernel/core/zephyr/subsys/net/lib/lwm2m/Kconfig"

endmenu

menu "Network Application Support"

source "ekernel/core/zephyr/subsys/net/lib/app/Kconfig"

source "ekernel/core/zephyr/subsys/net/lib/sockets/Kconfig"

endmenu
```
