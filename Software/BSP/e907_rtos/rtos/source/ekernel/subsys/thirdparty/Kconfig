## Software/BSP/openwrt/package/allwinner/eyesee-mpp/system/public/Config.in
```kconfig
if PACKAGE_eyesee-mpp-system

choice

prompt "select wifi-chip"
default wifi_disable
help
  "tell eyesee-mpp-system the used wifi chip"

config wifi_8189ftv
	bool "use wifi 8189ftv"

config wifi_ap6181
	bool "use wifi ap6181"

config wifi_ap6255
	bool "use wifi ap6255"

config wifi_ap6335
	bool "use wifi ap6335"

config wifi_xr819
	bool "use wifi xr819"

config wifi_disable
	bool "wifi disable"

endchoice

config mpp_system_newfs_msdos
	bool "enable newfs_msdos"
	default n
	help
	  newfs_msdos is for file system.

config mpp_system_reboot_efex
	bool "enable reboot_efex"
	default n
	help
	  reboot_efex is for burn directly.

config mpp_system_luaconfig
	bool "enable luaconfig"
	default n
	help
	  luaconfig is for parse lua script.

config mpp_system_wifi
	bool "enable wifi"
	default n
	help
	  wifi is for config wifi.

config mpp_system_smartlink
	bool "enable smartlink"
	default n
	help
	  smartlink is for ipc network link.

config mpp_system_rgb_ctrl
	bool "enable rgb_ctrl"
	default n
	select mpp_external_lz4
	help
	  rgb_ctrl is for osd.

config mpp_system_ntpclient
	bool "enable ntpclient"
	default n
	help
	  ntpclient is for network time.

endif
```

## Software/BSP/openwrt/package/allwinner/multimedia/tina_multimedia/machinfo/v851s/Config.in
```kconfig
menu "Select cedarx configuration options"
depends on PACKAGE_libcedarx

comment "Only need to play audio/video ---"
config ONLY_ENABLE_AUDIO
	default n
	bool "Only enable audio player"

config ONLY_DISABLE_AUDIO
	default n
	bool "Only disable audio player while playing a video"

comment "Middleware ---"
config TPLAYER
	select CEDAR_PARSER_ALL
	select CEDAR_STREAM_ALL
	default y
	bool "Select tplayer middleware"

config TRECORDER
	depends on (!ONLY_ENABLE_AUDIO)
	select CEDAR_VIDEO_ENCODER_ALL
	select CEDAR_AENCODER_ALL
	select CEDAR_MUXER_ALL
	default y
	bool "Select trecorder middleware"

	source "../../trecorder/Config.in"

config TMETADATARETRIVER
	depends on (!ONLY_ENABLE_AUDIO)
	default y
	bool "Select tmetadataretriver middleware"

config JPEGDECODER
	depends on (!ONLY_ENABLE_AUDIO) && CEDAR_VDECODER_MJPEG
	default y
	bool "Select JPEGDECODER middleware"

comment "Video Encoders ---"
config CEDAR_VIDEO_ENCODER_ALL
	depends on TRECORDER
	bool "Enable all cedarc video encoders"

comment "Muxers ---"

config CEDAR_MUXER_ALL
	depends on TRECORDER
	bool "Select muxers"

config CEDAR_AAC_MUXER
	depends on TRECORDER
	default y
	bool "Support aac muxer"

config CEDAR_TS_MUXER
	depends on TRECORDER
	default y
	bool "Support ts muxer"

config CEDAR_MP4_MUXER
	depends on TRECORDER
	default y
	bool "Support mp4 muxer"

comment "Audio Encoders ---"

config CEDAR_AENCODER_ALL
	depends on TRECORDER
	bool "Select all audio encoders"

comment "Video Decoders ---"

config CEDAR_VDECODER_H264
	depends on (!ONLY_ENABLE_AUDIO)
	default y
	bool "AVC(h.264) video decoder"

config CEDAR_VDECODER_AVS
	depends on (!ONLY_ENABLE_AUDIO)
	default y
	bool "AVS video decoder"

config CEDAR_VDECODER_H265
	depends on (!ONLY_ENABLE_AUDIO)
	default y
	bool "H265 video decoder"

config CEDAR_VDECODER_MJPEG
	depends on (!ONLY_ENABLE_AUDIO)
	default y
	bool "MJPEG(motion jpeg) video decoder"

config CEDAR_VDECODER_MPEG2
	depends on (!ONLY_ENABLE_AUDIO)
	default y
	bool "MPEG2 video decoder"

config CEDAR_VDECODER_MPEG4BASE
	depends on (!ONLY_ENABLE_AUDIO)
	default y
	bool "MPEG4 base profile video decoder"

config CEDAR_VDECODER_MPEG4DX
	depends on (!ONLY_ENABLE_AUDIO) && CEDAR_VDECODER_MPEG4BASE
	default y
	bool "mpeg4 DIVX video decoder"

config CEDAR_VDECODER_MPEG4H263
	depends on (!ONLY_ENABLE_AUDIO) && CEDAR_VDECODER_MPEG4BASE
	default y
	bool "H263 video decoder"

config CEDAR_VDECODER_MPEG4NORMAL
	depends on (!ONLY_ENABLE_AUDIO) && CEDAR_VDECODER_MPEG4BASE
	default y
	bool "MPEG4 normal video decoder"

config CEDAR_VDECODER_MPEG4VP6
	depends on (!ONLY_ENABLE_AUDIO) && CEDAR_VDECODER_MPEG4BASE
	default n
	bool "VP6 video decoder"

config CEDAR_VDECODER_VP8
	depends on (!ONLY_ENABLE_AUDIO)
	default y
	bool "VP8 video decoder"

config CEDAR_VDECODER_VP9
	depends on (!ONLY_ENABLE_AUDIO)
	default n
	bool "VP9 video decoder"

config CEDAR_VDECODER_WMV3
	depends on (!ONLY_ENABLE_AUDIO)
	default y
	bool "VC1(WMV3) video decoder"

comment "Audio Decoders ---"

config CEDAR_ADECODER_AAC
	default y
	bool "AAC audio decoder"

config CEDAR_ADECODER_ALAC
	default y
	bool "ALAC audio decoder"

config CEDAR_ADECODER_AMR
	default y
	bool "AMR audio decoder"

config CEDAR_ADECODER_APE
	default y
	bool "APE audio decoder"

config CEDAR_ADECODER_ATRC
	default y
	bool "ATRC audio decoder"

config CEDAR_ADECODER_FLAC
	depends on TPLAYER
	default y
	bool "FLAC audio decoder"

config CEDAR_ADECODER_MP3
	default y
	bool "MP3 audio decoder"

config CEDAR_ADECODER_OGG
	default y
	bool "OGG audio decoder"

config CEDAR_ADECODER_SIPR
	default y
	bool "SIPR audio decoder"

config CEDAR_ADECODER_WAV
	default y
	bool "WAV audio decoder"

config CEDAR_ADECODER_RA
	default y
	bool "RA audio decoder"

config CEDAR_ADECODER_DSD
	default y
	bool "DSD audio decoder"

config CEDAR_ADECODER_G729
	default y
	bool "G729 audio decoder"

config CEDAR_ADECODER_OPUS
	default y
	bool "OPUS audio decoder"

comment "Subtitle Decoders ---"

config CEDAR_SUBTITLE_SUPPORT
	depends on (!ONLY_ENABLE_AUDIO)
	default y
	bool "Select all subtitle decoders"

comment "Parsers ---"
config CEDAR_PARSER_ALL
	depends on TPLAYER
	bool "Select  parsers"

config CEDAR_PARSER_AAC
	depends on TPLAYER
	default y
	bool "Select aac parser"

config CEDAR_PARSER_MP3
	depends on TPLAYER
	default y
	bool "Select mp3 parser"

config CEDAR_PARSER_WAV
	depends on TPLAYER
	depends on CEDAR_PARSER_MP3
	default y
	bool "Select wav parser"

config CEDAR_PARSER_ID3V2
	depends on TPLAYER
	default y
	bool "Select id3v2 parser"

config CEDAR_PARSER_FLAC
	depends on TPLAYER
	default y
	bool "Select flac parser"

config CEDAR_PARSER_APE
	depends on TPLAYER
	default y
	bool "Select ape parser"

config CEDAR_PARSER_AMR
	depends on TPLAYER
	default y
	bool "Select amr parser"

config CEDAR_PARSER_ATRAC
	depends on TPLAYER
	default y
	bool "Select atrac parser"

config CEDAR_PARSER_OGG
	depends on TPLAYER
	default y
	bool "Select ogg parser"

config CEDAR_PARSER_TS
	depends on TPLAYER
	default y
	bool "Select ts parser"

config CEDAR_PARSER_MKV
	depends on TPLAYER && (!ONLY_ENABLE_AUDIO)
	default y
	bool "Select mkv parser"

config CEDAR_PARSER_MOV
	depends on TPLAYER
	default y
	bool "Select mov parser"

config CEDAR_PARSER_AVI
	depends on TPLAYER && (!ONLY_ENABLE_AUDIO)
	default y
	bool "Select avi parser"

config CEDAR_PARSER_FLV
	depends on TPLAYER && (!ONLY_ENABLE_AUDIO)
	default y
	bool "Select flv parser"

config CEDAR_PARSER_ASF
	depends on TPLAYER && (!ONLY_ENABLE_AUDIO)
	default y
	bool "Select asf parser"

config CEDAR_PARSER_HLS
	depends on TPLAYER
	default y
	bool "Select hls parser"

config CEDAR_PARSER_MPG
	depends on TPLAYER && (!ONLY_ENABLE_AUDIO)
	default y
	bool "Select mpg parser"

config CEDAR_PARSER_PLS
	depends on TPLAYER && (!ONLY_ENABLE_AUDIO)
	default y
	bool "Select pls parser"

comment "Streams ---"

config CEDAR_STREAM_ALL
	depends on TPLAYER
	bool "Select  streams"

config CEDAR_FILE_STREAM
	depends on TPLAYER
	default y
	bool "Support file stream"

config CEDAR_HTTP_STREAM
	depends on TPLAYER
	default y
	bool "Support http stream"

config CEDAR_HTTPS_STREAM
	depends on TPLAYER
	depends on CEDAR_HTTP_STREAM
	default y
	bool "Support https stream"

config CEDAR_RTSP_STREAM
	depends on TPLAYER
	default n
	bool "Support rtsp stream"

comment "OMX interface support ---"
config OMX
	depends on TPLAYER && TRECORDER
	select PACKAGE_libstdcpp
	default y if CONFIG_PACKAGE_gst-omx=y
	bool "Add for openmax support"
endmenu

menu "Select Cedarx memory options"
depends on PACKAGE_libcedarx
config CUSTOM_VBV_ENABLE
	depends on TPLAYER
	default n
	bool "Set VBV size by customer"

config VBVBUFSIZE
	depends on CUSTOM_VBV_ENABLE
	default 1
	int "Set VBV buffer size for tplayer in MB"

config SCALE_DOWN_ENABLE
	depends on TPLAYER
	default n
	bool "Set Custom scaledown enable"

config SCALE_DOWN_WIDTH_LIMIT
	depends on SCALE_DOWN_ENABLE
	default 1920
	int "Do scaledown when width is equal or beyond this value"

config SCALE_DOWN_RATIO
	depends on SCALE_DOWN_ENABLE
	default 1
	int "Scale down ratio which can be 1,2 or 3"

config CUSTOM_FBM_NUM_ENABLE
	depends on TPLAYER
	default n
	bool "Set FBM number by customer"

config FBM_DISPLAY_HOLDING
	depends on CUSTOM_FBM_NUM_ENABLE
	default 3
	int "FBM number which display holds"

config FBM_DEINTERLEACED_USED
	depends on CUSTOM_FBM_NUM_ENABLE
	default 2
	int "FBM number deinterleace use"

config FBM_ROTATE_USED
	depends on CUSTOM_FBM_NUM_ENABLE
	default 0
	int "FBM numer rotate used"

config FBM_SMOOTHLY_USED
	depends on CUSTOM_FBM_NUM_ENABLE
	default 3
	int "FBM number which used to play smoothly"

config USE_ION_BUF_ENABLE
	depends on TPLAYER
	default n
	bool "Set ion enable"

config CUSTOM_CACHE_ENABLE
	depends on TPLAYER
	default n
	bool "Set cache size by customer"

config CACHE_BUFFER_SIZE
	depends on CUSTOM_CACHE_ENABLE
	default 20480
	int "Set cache buffer size for tplayer in KB"

config LIVE_CACHE_BUFFER_SIZE
	depends on CUSTOM_CACHE_ENABLE
	default 20480
	int "Set live cache buffer size for tplayer in KB"

config HTTP_STREAM_CACHE_SIZE
	depends on CUSTOM_CACHE_ENABLE
	default 5120
	int "Set http cache size for tplayer in KB"

config START_PLAY_CACHE_TIME
	depends on CUSTOM_CACHE_ENABLE
	default 5
	int "Set start play cache time for tplayer in SECOND"

endmenu

choice
prompt "Choose whether to use VIN ISP"
	depends on PACKAGE_libcedarx
	default TR_NO_USE_VIN_ISP
	help
		Choose whether to compile VIN ISP.
config TR_YES_USE_VIN_ISP
	select PACKAGE_libAWIspApi
	bool "YES"
config TR_NO_USE_VIN_ISP
	bool "NO"
endchoice
```

## Software/BSP/openwrt/target/v851s/generic/image/Config.in
```kconfig
config SUNXI_SD_BOOT_PART
	bool "Build filesystem for Boot (SD Card) partition"
	default n

config SUNXI_SD_BOOT_PARTSIZE
	int "Boot (SD Card) filesystem partition size (in MB)"
	depends on SUNXI_SD_BOOT_PART
	default 4

choice
	prompt "Boot (SD Card) Kernel format"
	default uImage

	config SUNXI_SD_BOOT_KERNEL_FORMAT_UIMAGE
	bool "uImage"

	config SUNXI_SD_BOOT_KERNEL_FORMAT_BOOTIMG
	bool "boot.img"
endchoice

config SUNXI_MKBOOTIMG_WITH_COMPRESS_KERNEL
	bool "mkbootimge with compressed kernel"
	depends on SUNXI_SD_BOOT_KERNEL_FORMAT_BOOTIMG
	default n

config SUNXI_MKBOOTIMG_ADD_DTB
	bool "mkbootimge add dtb to boot.img"
	depends on SUNXI_SD_BOOT_KERNEL_FORMAT_BOOTIMG
	default n

config SUNXI_SMALL_STORAGE_OTA
	bool "For storage less than 32M, enable this when using ota"
	default n

config SUNXI_RECOVERY_INITRAMFS_PART
	bool "Build filesystem for Boot-Recovery initramfs partition"
	default n

config SUNXI_RECOVERY_INITRAMFS_PARTSIZE
	int "Boot-Recovery initramfs filesystem partition size (in MB)"
	depends on SUNXI_RECOVERY_INITRAMFS_PART
	default 7


choice
	prompt "Boot-Recovery initramfs Kernel format"
	default uImage

	config SUNXI_RECOVERY_INITRAMFS_KERNEL_FORMAT_UIMAGE
	bool "uImage"

	config SUNXI_RECOVERY_INITRAMFS_KERNEL_FORMAT_BOOTIMG
	bool "boot.img"
endchoice

config SUNXI_SEPARATE_APP_FROM_ROOTFS
	bool "Separate /mnt/app from rootfs"
	default n

config SUNXI_SEPARATE_DATA_FROM_ROOTFS
	bool "Separate /data from rootfs"
	default n

menuconfig CUSTOMIZE_IMAGE_NAME
	bool "customize image name"
	default n
	help
	   Customize image name

	choice
		prompt "Boot Image(kernel) name suffix"
		default CONFIG_BOOT_IMAGE_NAME_SUFFIX_NONE
		depends on CUSTOMIZE_IMAGE_NAME
		help
		   Customize Boot image(kernel) name

		config SUNXI_BOOT_IMAGE_NAME_SUFFIX_NONE
		bool "boot.img/boot_initramfs.img"

		config SUNXI_BOOT_IMAGE_NAME_SUFFIX_RECOVERY
		bool "boot_recovery.img/boot_initramfs_recovery.img"

		config SUNXI_BOOT_IMAGE_NAME_SUFFIX_RAMFS
		bool "boot_ramfs.img/boot_initramfs_ramfs.img"
	endchoice

	choice
		prompt "Rootfs Image name suffix"
		default CONFIG_ROOTFS_IMAGE_NAME_SUFFIX_NONE
		depends on CUSTOMIZE_IMAGE_NAME
		help
		   Customize rootfs image name

		config SUNXI_ROOTFS_IMAGE_NAME_SUFFIX_NONE
		bool "rootfs.img"

		config SUNXI_ROOTFS_IMAGE_NAME_SUFFIX_RECOVERY
		bool "rootfs_recovery.img"

		config SUNXI_ROOTFS_IMAGE_NAME_SUFFIX_RAMFS
		bool "rootfs_ramfs.img"
	endchoice

menuconfig CUSTOMIZE_CONFIG_FILE
	bool "customize config file"
	default n
	help
	   Customize image config file

	choice
		prompt "Kernel config file suffix"
		default KERNEL_CONFIG_FILE_SUFFIX_NONE
		depends on CUSTOMIZE_CONFIG_FILE
		help
		  Customize kernel config file

		config KERNEL_CONFIG_FILE_SUFFIX_NONE
		bool "config-x.x"

		config KERNEL_CONFIG_FILE_SUFFIX_RECOVERY
		bool "config-x.x_recovery"

		config KERNEL_CONFIG_FILE_SUFFIX_RAMFS
		bool "config-x.x_ramfs"
	endchoice

	menuconfig TARGET_ROOTFS_INCLUDE_KERNEL
		bool "Include kernel in root filesystem"
		depends on TARGET_ROOTFS_UBIFS || TARGET_ROOTFS_EXT4FS
		default n
		help
		  Include the kernel image in the rootfs. Typically, the image is placed
		  below /boot.

		config TARGET_ROOTFS_INCLUDE_UIMAGE
			bool "include uImage" if TARGET_ROOTFS_INCLUDE_KERNEL
			default y
			help
			  This option might not apply to all targets. Make sure
			  to check target/allwinner/<your_target>/image/Makefile to
			  see if this option will have any effect.

		config TARGET_ROOTFS_INCLUDE_ZIMAGE
			bool "include zImage" if TARGET_ROOTFS_INCLUDE_KERNEL
			default y
			help
			  This option might not apply to all targets. Make sure
			  to check target/allwinner/<your_target>/image/Makefile to
			  see if this option will have any effect.

		config TARGET_ROOTFS_INCLUDE_FIT
			bool "include FIT" if TARGET_ROOTFS_INCLUDE_KERNEL
			default y
			help
			  This option might not apply to all targets. Make sure
			  to check target/allwinner/<your_target>/image/Makefile to
			  see if this option will have any effect.

	config TARGET_ROOTFS_INCLUDE_DTB
		bool "Include DTB in root filesystem"
		depends on USES_DEVICETREE && (TARGET_ROOTFS_UBIFS || TARGET_ROOTFS_EXT4FS)
		default n
		help
		  Include the device tree blob file(s) in the rootfs. Typically the DTBs
		  are placed below /boot.

	comment "Kernel Image Compression Mode setting"

	menuconfig TARGET_KERNEL_COMPRESSION_MODE
		bool "kernel compression mode setting"
		default n
		help
		  setting kernel image compression mode.

		choice
			prompt "Compression"
			default KERNEL_KERNEL_GZIP
			depends on TARGET_KERNEL_COMPRESSION_MODE
			help
			  Select kernel image compression.

			config KERNEL_KERNEL_GZIP
				bool "Gzip"

			config KERNEL_KERNEL_LZMA
				bool "LZMA"

			config KERNEL_KERNEL_XZ
				bool "XZ"

			config KERNEL_KERNEL_LZO
				bool "LZO"
		endchoice

	comment "Downsize root filesystem"

	config REDUCE_ROOTFS_SIZE
		bool "downsize the root filesystem or initramfs"
		default n
		help
		  This option will reduce the storage size of the rootfs. Please read file
		  scripts/reduce-rootfs-size.sh.

	comment "Optimize kernel size"

	config REDUCE_KERNEL_SIZE
		bool "downsize the kernel size (EXPERIMENTAL)"
		default n
		help
		  This option will reduce the storage size of the kernel by removing log
		  and debug information. Please read file scripts/reduce-kernel-size.sh

	comment "Boot Time Optimization"

	config BOOT_TIME_OPTIMIZATION
		bool "Boot Time Optimization"
		depends on KERNEL_KERNEL_LZO && ( KERNEL_SQUASHFS_ZLIB || TARGET_ROOTFS_EXT4FS)
		default n
		help
		  This option will optimize boot time.


	config SUNXI_MAKE_REDUNDANT_ENV
		bool "sunxi make redundant env data"
		default n
		help
		  Create redundant env data with mkenvimage tools

	config SUNXI_REDUNDANT_ENV_SIZE
		string "redundant env data size"
		depends on SUNXI_MAKE_REDUNDANT_ENV
		default 0x20000
		help
		 redundant env data size
```
