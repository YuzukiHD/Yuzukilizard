## Software/BSP/e907_rtos/rtos/source/ekernel/subsys/thirdparty/Kconfig
```kconfig
source "ekernel/subsys/thirdparty/dfs/Kconfig"
source "ekernel/subsys/thirdparty/openamp/Kconfig"
```

## Software/BSP/e907_rtos/rtos/source/ekernel/subsys/thirdparty/dfs/filesystems/layerfs/Kconfig
```kconfig
menu "Layerfs Cache Support"

config LAYERFS_CACHE_SUPPORT
    bool "Layer Cache Support Option"
    default n
    help
       Layer Cache Support Option

config LAYERFS_CACHE_SECTOR_ALIGN
    bool "Sector Algin Cache"
    default n
    depends on LAYERFS_CACHE_SUPPORT
    help
       Use A Sector Aligned Buffer for read-only files

config LAYERFS_CACHE_BYTE_ALIGN
    bool "Byte Algin Cache"
    default n
    depends on LAYERFS_CACHE_SUPPORT
    help
       Use A Byte Aligned Buffer for read-only files.

config LAYERFS_CACHE_HERB
    bool "Write Cache"
    default n
    depends on LAYERFS_CACHE_SUPPORT
    help
       Use Buffer for write-only files.

config LAYERFS_CACHE_DEBUG
    bool "Layerfs Cache Debug"
    default n
    depends on LAYERFS_CACHE_SUPPORT
    help
       Layer Cache Debug Option

endmenu
```

## Software/BSP/openwrt/package/allwinner/eyesee-mpp/external/Config.in
```kconfig
if PACKAGE_eyesee-mpp-external

config mpp_external_sqlite
	bool "enable sqlite"
	help
	  sqlite cpp version.

config mpp_external_civetweb
	bool "enable civetweb"
	help
	  civetweb for web.

config mpp_external_lz4
	bool "enable lz4"
	help
	  lz4 for compress.

config mpp_external_uvoice
	bool "enable uvoice"
	help
	  uvoice lib is used to analyse audio to get command.
	  If need it, enable uvoice libs in mpp-external.

config mpp_external_jsoncpp
	bool "compile jsoncpp"
	help
	  if need jsoncpp, add it.

endif
```

## Software/BSP/openwrt/package/allwinner/eyesee-mpp/framework/Config.in
```kconfig
if PACKAGE_eyesee-mpp-framework

config mpp_framework_videoresizer
	bool "support video resizer"
	help
	  video resizer can decode big picture and encode it to small picture.
	  If need it, enable videoResizer in framework.

endif
```
